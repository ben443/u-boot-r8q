## board/samsung/samsung-mobile/Kconfig
```kconfig
if TARGET_EXYNOS_MOBILE

config ENV_SOURCE_FILE
	default "samsung-mobile"

config LNX_KRNL_IMG_TEXT_OFFSET_BASE
	default TEXT_BASE

config SYS_BOARD
	default "samsung-mobile"

config SYS_CONFIG_NAME
	default "samsung-mobile"

config SYS_VENDOR
	default "samsung"

endif # TARGET_EXYNOS_MOBILE
```
